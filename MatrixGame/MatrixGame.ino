


const PROGMEM byte db[512][10] = {
{ 0, 0, 0, 0, 0, 0, 0, 0, 0 ,  0 } ,
{ 0, 0, 0, 0, 0, 0, 0, 0, 1 ,  0 } ,
{ 0, 0, 0, 0, 0, 0, 0, 1, 0 ,  0 } ,
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{ 1, 1, 1, 1, 1, 1, 1, 1, 1 ,  0 } 
};

short validPos[512];



// it uses  Keypad library by Mark Stanley and Alexander Brevig.
#include <Keypad.h>

const byte ROWS = 3;
const byte COLS = 3;
//define the cymbols on the buttons of the keypads
char hexaKeys[ROWS][COLS] = {
  {1,2,3},
  {4,5,6},
  {7,8,9}
};
byte rowPins[ROWS] = {5, 6, 7}; //connect to the row pinouts of the keypad
byte colPins[COLS] = {2, 3, 4}; //connect to the column pinouts of the keypad

//initialize an instance of class NewKeypad
Keypad customKeypad = Keypad( makeKeymap(hexaKeys), rowPins, colPins, ROWS, COLS);


#include <Wire.h> 
#include <LiquidCrystal_I2C.h>

// Constructor de la librería de LCD 16x2
// Aqui se configuran los pines asignados a la pantalla del PCF8574
LiquidCrystal_I2C lcd(0x27, 2, 1, 0, 4, 5, 6, 7, 3, POSITIVE);
 


#define latchPin 12
#define clockPin  11
#define dataPin  A0
#define oePin 13

#define ledRL 9
#define ledGL 8
#define ledRD A1
#define ledGD 10

int matrixRed[9][3] = {
  {0x02,0x00,0x00},  // 100 000 000
  {0x00,0x02,0x00},  // 010 000 000
  {0x00,0x00,0x02},  // 001 000 000
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  {0x00,0x00,0x08}   // 000 000 001
};

int matrixGreen[9][3] = {
  {0x40,0x00,0x00},  // 100 000 000
  {0x00,0x40,0x00},  // 010 000 000
  {0x00,0x00,0x40},  // 001 000 000
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  {0x00,0x00,0x10}   // 000 000 001
};

int matrix[3] = {0x00,0x00,0x00};

int matrixVal[9] = {
  -1, -1, -1,
  -1, -1, -1,
  -1, -1, -1
 };

int valButton = 0;
int turn;
int count0 = 0;
int count1 = 0;

byte redBlink = 0;
byte greenBlink = 0;

unsigned long oldMicros = 0;
unsigned long blinkDelay = 100000;
byte blinkState = 0;


void setup() {
  pinMode(0, OUTPUT);
  pinMode(1, OUTPUT);
  digitalWrite(0, LOW);
  digitalWrite(1, LOW);
 
  pinMode(latchPin, OUTPUT);
  pinMode(clockPin, OUTPUT);
  pinMode(dataPin, OUTPUT);
  pinMode(oePin, OUTPUT);
  digitalWrite(oePin, HIGH);
  delay(3);
  digitalWrite(oePin, LOW);

  // Matrix to zero
  digitalWrite(latchPin, LOW);
  for (int i=0; i<3; i++){
    // Third shift register -> Second shift register -> First shift register
    shiftOut(dataPin, clockPin, LSBFIRST, 0);
  }
  digitalWrite(latchPin, HIGH);

  pinMode(ledRL, OUTPUT);
  pinMode(ledGL, OUTPUT);
  pinMode(ledRD, OUTPUT);
  pinMode(ledGD, OUTPUT);

  randomSeed(analogRead(2));
  int randomNum = random(0,100);
  turn = randomNum%2;
  
  if(turn) {
    digitalWrite(ledRL, LOW);
    digitalWrite(ledGL, HIGH);
  } else {
    digitalWrite(ledRL, HIGH);
    digitalWrite(ledGL, LOW);
  }

  digitalWrite(ledRD, LOW);
  digitalWrite(ledGD, LOW);

  // generate pos
  for (short i=0; i<512; i++) {
    validPos[i] = i;  
  }

  // Indicar a la libreria que tenemos conectada una pantalla de 16x2
  lcd.begin(16, 2);
  // Mover el cursor a la primera posición de la pantalla (0, 0)
  lcd.home ();
  // Imprimir "Hola Mundo" en la primera linea
  lcd.print("Matrix Game");
  // Mover el cursor a la segunda linea (1) primera columna
  lcd.setCursor ( 0, 1 );
  // Imprimir otra cadena en esta posicion
  lcd.print("Player ");
  lcd.setCursor ( 7, 1 );
  lcd.print(turn); 
  lcd.setCursor ( 8, 1 );
  lcd.print(" Starts!"); 
  
  

}

void loop() {

if (micros() >= oldMicros) {
  oldMicros = micros() + blinkDelay;
  if (blinkState == 0) {
    blinkState = 1;

    if (redBlink == 1) {
      digitalWrite(ledRD, HIGH);
    }
    if (greenBlink == 1) {
      digitalWrite(ledGD, HIGH);
    }
  } else if (blinkState == 1) {
    blinkState = 0;
    digitalWrite(ledRD, LOW);
    digitalWrite(ledGD, LOW);
  } 
}

  
  valButton = customKeypad.getKey();
  if (valButton !=0) {
    // Serial.print("Button Clicked: ");
    // Serial.println(valButton);

    if (matrixVal[valButton-1] < 0) {
      // Matrix value update
      matrixVal[valButton-1] = turn;
      // Matrix visual update
      for (int i=0; i<3; i++){
        if (turn) {
          matrix[i] |= matrixGreen[valButton-1][i];
        } else {
          matrix[i] |= matrixRed[valButton-1][i];
        }
      }

      // Matrix change
      digitalWrite(latchPin, LOW);
      for (int i=0; i<3; i++){
        // Third shift register -> Second shift register -> First shift register
        shiftOut(dataPin, clockPin, LSBFIRST, matrix[i]);
      }
      digitalWrite(latchPin, HIGH);



      // Get valid position in db
      for(int i=0; i<512; i++) {
        // Remove position that does not exist
        
        if (pgm_read_byte_near(&(db[i][valButton-1])) != turn) {
          validPos[i] = -1;
        }
      }
      
      
      // Compute possibilities
      count0 = 0;
      count1 = 0;
      for(int i=0; i<512; i++) {
        if (validPos[i] != -1) {
          if (pgm_read_byte_near(&(db[i][9])) == 0) {
            count0++; 
          } else {
            count1++;
          }
        }
      }

      // Tell who is winning
      if (count0 > count1) {
        redBlink = 1;
        greenBlink = 0;
      } else if (count0 < count1) {
        redBlink = 0;
        greenBlink = 1;
      } else {
        redBlink = 1;
        greenBlink = 1;
      }
      
      /*
      Serial.print("Player 0: ");
      Serial.println(count0);
      Serial.print("Player 1: ");
      Serial.println(count1);
      */

      // Change turn
      if(turn) {
        turn = 0;
        digitalWrite(ledRL, HIGH);
        digitalWrite(ledGL, LOW);
      } else {
        turn = 1;
        digitalWrite(ledRL, LOW);
        digitalWrite(ledGL, HIGH);
      }

      // Update Screen
      lcd.clear();
      lcd.home ();
      lcd.print("Player 0: ");
      lcd.setCursor ( 10, 0 );
      lcd.print(count0);      
      if (turn == 0) {
        lcd.setCursor ( 13, 0 );
        lcd.print("<-");
      }
      lcd.setCursor ( 0, 1 );
      lcd.print("Player 1: ");
      lcd.setCursor ( 10, 1 );
      lcd.print(count1);
      if (turn == 1) {
        lcd.setCursor ( 13, 1 );
        lcd.print("<-");
      }

      // Tell if play is end
      if (count1 == 0) {
        // No more blink
        blinkState = 2;
        digitalWrite(ledRD, HIGH);
        digitalWrite(ledGD, LOW);
        // Update Screen
        lcd.clear();
        lcd.home ();
        lcd.print("Player 0 Wins!!");
      }
      if (count0 == 0) {
        // No more blink
        blinkState = 2;
        digitalWrite(ledGD, HIGH);
        digitalWrite(ledRD, LOW);
        // Update Screen
        lcd.clear();
        lcd.home ();
        lcd.print("Player 1 Wins!!");
      }

    }
  }

}
